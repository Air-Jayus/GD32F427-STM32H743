/* Copyright (C) 2019 *****************************************************************************
									 杭州科强智能控制系统有限公司
====================================================================================================
项目名称：T6H5型注塑机控制器
项目简介：新一代注塑机控制器的软、硬件平台。软件方面要达到易扩展、易维护之目的。

======================================== 文   件    信   息 ========================================
文件名称：DigiLed_Drv.c
文件说明：数码管驱动

作    者：SL
编写时间：2019.10
======================================== 修   改    历   史 ========================================
修 改 人：
修改日期：
修改说明：

修 改 人：
修改日期：
修改说明：
======================================== 其   它    说   明 ========================================
使用驱动芯片:sn74hc164
1、LED主要用于系统状态的指示，秒点闪表示程序在运行，显示数字代表系统状态，详见.h文件定义。
2、要显示的状态通过SetDigiLed()函数设置，且该函数必须重复调用，直到状态改变。

****************************************************************************************************/
//#define mSysDebug		

#ifndef DigiLed_Drv_c
	#define DigiLed_Drv_c
#endif

#include "Include.h"
/*======================================== 模块内有效宏定义 =======================================*/
#define mDLD_DP		0x7F		//小数点
#define mDLD_AllOff	0xFF		//显示全灭
#define	mDLD_AllOn	0x00		//显示全亮

#define H164CLK_L  GPIO_BC(GPIOB)	=mBit14		//引脚PB14置低
#define H164CLK_H  GPIO_BOP(GPIOB)	=mBit14		//引脚PB14置高
#define H164DAT_L  GPIO_BC(GPIOB)	=mBit15		//引脚PB15置低
#define H164DAT_H  GPIO_BOP(GPIOB)	=mBit15     //引脚PB15置高
/*======================================= 模块内有效变量定义 ======================================*/
U8 const DigiLedDispTab[]={ 	//数码LED显示转换表	0-F
  0xC0,0xF9,0xA4,0xB0,0x99,0x92,0x82,0xF8,0x80,0x90,0x88,0x83,0xC6,0xA1,0x86,0x8E};
U8 DigiLedBuff;		//显示缓存

/*======================================= 模块内有效函数声明 ======================================*/ 
void Dly10ns(U32 DlyTi);						//延时n*10ns	
void DigiLedOut(U8 data);
/****************************************************************************************************
函数名称：int main(void)
函数说明：主函数
输入参数：
返 回 值：
其    它：为方便本文件中函数调试而设
****************************************************************************************************/
#ifdef mSysDebug
int main(void)
{           
	do{
	}while(mTrue);
}
#endif	//mSysDebug

/****************************************************************************************************
函数名称：数码LED初始化
函数说明：显示秒点
输入参数：
返 回 值：
其    它：
****************************************************************************************************/
void DigiLed_Init(void)
{
	//管脚
 	rcu_periph_clock_enable(RCU_GPIOB);   	//使能PORTD口时钟  
 	gpio_mode_set(GPIOB, GPIO_MODE_OUTPUT, GPIO_PUPD_PULLUP, mBit14|mBit15);
    gpio_output_options_set(GPIOB, GPIO_OTYPE_PP, GPIO_OSPEED_50MHZ,mBit14|mBit15);
	DigiLedOut(mDLD_AllOn);//全亮
}
/****************************************************************************************************
函数名称：数码LED显示处理
函数说明：根据LedControler结构内容输出显示 
输入参数：
返 回 值：
其    它：	此函数需要每0.1S调用一次
****************************************************************************************************/
void DigiLed_Pcs(void)
{
	static G10usTimer DLTimer;		//定时器
  static U8 DigiLedState=0;//数码管显示状态。利用状态机使每个状态数码管输出只写一次，防止每个循环一直输出，提高数码管驱动效率
		#define DigiLedEst 0 //复位状态
		#define DigiLedON  1 //数码管显示亮
		#define DigiLedOFF 2 //数码管显示全灭或小数点灭
	if(G10usTimerLess(&DLTimer,T100msTo10us(3)))
	{	//亮
		if(DigiLedState==DigiLedEst)//如果数码管为复位状态
		{
			DigiLedOut(DigiLedDispTab[DigiLedBuff&0x0f]&mDLD_DP);
			DigiLedState=DigiLedON;//数码管显示亮
		}
	}
	else if(G10usTimerLess(&DLTimer,T100msTo10us(8)))
	{	//闪灭
		if(DigiLedState==DigiLedON)////如果数码管为亮状态
		{
			if(DigiLedBuff&mBit7)
				DigiLedOut(mDLD_AllOff);//闪			全灭
			else
				DigiLedOut(DigiLedDispTab[DigiLedBuff&0x0f]);//不闪		仅小数点灭
			DigiLedState=DigiLedOFF;//数码管显示全灭或小数点灭
		}
	}
	else
	{		
		G10usTimerRes(&DLTimer);
		DigiLedState=DigiLedEst;//数码管显示复位
		DigiLedBuff=0;	//复位显示缓存
	}
}

/****************************************************************************************************
函数名称：	设置数码LED显示
函数说明：
输入参数：	U8 DispCode	低4位为显示内容，高4位为显示状态（Bit7代表闪烁、Bit6-4暂保留）
返 回 值：
其    它：
1、如果要持续显示某状态，需重复调用本函数。
2、数值越大，显示优先级越高。
****************************************************************************************************/
void SetDigiLed(U8 DispCode)
{
	if(DispCode>DigiLedBuff)
		DigiLedBuff=DispCode;
}
/****************************************************************************************************
函数名称：	数码LED显示输出
函数说明：
输入参数：	
返 回 值：
其    它：该函数实际测量的CLK周期为95ns
****************************************************************************************************/
void DigiLedOut(U8 data)
{
	U8 i;
	for(i=0;i<8;i++)
	{			
    H164CLK_L;			
		if(data&0x80) H164DAT_H;		
		else  H164DAT_L;
		__NOP();
		H164CLK_H;
		__NOP();
		data=data<<1;
	}	
}
/****************************************************************************************************
以下是应用级驱动函数：基于部分硬件完成应用功能
****************************************************************************************************/
/****************************************************************************************************
以下是硬件级驱动函数：完全基于硬件
****************************************************************************************************/
